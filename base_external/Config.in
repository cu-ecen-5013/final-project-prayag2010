## base_external/Config.in
```kconfig
source "$BR2_EXTERNAL_assignment_base_PATH/package/epaper-module/Config.in"
source "$BR2_EXTERNAL_assignment_base_PATH/package/scapp/Config.in"
source "$BR2_EXTERNAL_assignment_base_PATH/package/einkapp/Config.in"
source "$BR2_EXTERNAL_assignment_base_PATH/package/clientapp/Config.in"
```
